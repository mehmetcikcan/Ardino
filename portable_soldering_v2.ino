static const unsigned char PROGMEM  press_logo[] =
{ 
B00000000, B00000000, B00000000, B00000000, B00000000, B00000000, B00000000, B00000000, B00000000, B00000000, B00000000, B00000000, B00000000, B00000000, B00000000, B00000000,
B00000000, B00000000, B00000000, B00000000, B00000000, B00000000, B00000000, B00000000, B00000000, B00000000, B00000000, B00000000, B00000000, B00000000, B00000000, B00000000,
B11111001, B11110011, B11100111, B11001111, B10000000, B00000000, B00000000, B00000000, B00000000, B00000000, B00000000, B00000000, B00000000, B00000000, B00000000, B00000000,
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B00000000, B00000000, B00000000, B00000000, B00000000, B00000000, B00000000, B00000000, B00000000, B00000000, B00000000, B00000000, B00000000, B00000000, B00000000, B00000000
  };
  

static const unsigned char PROGMEM no_press_logo[] =
{ 
B00000000, B00000000, B00000000, B00000000, B00000000, B00000000, B00000000, B00000000, B00000000, B00000000, B00000000, B00000000, B00000000, B00000000, B00000000, B00000000,
B00000000, B00000000, B00000000, B00000000, B00000000, B00000000, B00000000, B00000000, B00000000, B00000000, B00000000, B00000000, B00000000, B00000000, B00000000, B00000000,
B11111001, B11110011, B11100111, B11001111, B10000000, B00000000, B00000000, B00000000, B00000000, B00000000, B00000000, B00000000, B00000000, B00000000, B00000000, B00000000,
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B00000000, B00000000, B00000000, B00000000, B00000000, B00000000, B00000000, B00000000, B00000000, B00000000, B00000000, B00000000, B00000000, B00000000, B00000000, B00000000
};

///////////////////////////////////////////////////////////////////////////////////////////////////////////////////////////////////////

#include <SPI.h>                   
#include <Wire.h>
#include <Adafruit_GFX.h>
#include <Adafruit_SSD1306.h> 
#include <FastPID.h>

///////////////////////////////////////////////////////////////////////////////////////////////////////////////////////////////////////

#define OLED_RESET 8
Adafruit_SSD1306 display(OLED_RESET);
#define NUMFLAKES 5
#define XPOS 0
#define YPOS 1
#define DELTAY 2
#if (SSD1306_LCDHEIGHT != 32)
#error("Height incorrect, please fix Adafruit_SSD1306.h!");
#endif
///////////////////////////////////////////////////////////////////////////////////////////////////////////////////////////////////////

int MOSFET_pin = 3;
int increase_pin = 7;
int decrease_pin = 4;
int vibrate = A1;    
int temp_sense = A0; 
int buzzer = 5;      

///////////////////////////////////////////////////////////////////////////////////////////////////////////////////////////////////////

float Kp=6, Ki=0.055, Kd=0.86, Hz=10;
int output_bits = 8;                 
bool output_signed = false;
FastPID myPID(Kp, Ki, Kd, Hz, output_bits, output_signed);

float min_temp = 200;
float max_temp = 500;
float Delay=300;     
int   setpoint = 300;
unsigned long sleep_time_detect = 120000; 

float temperature_read;
int logo_slide =128;
int temp_to_print = 0;
int i = 0;
int i_prev = 0;
bool set_temp_made = false;

int sleep_out_count = 0;
int temp_change_count = 0;
int both_pressed_count = 0;
int sleeplogo_count = 0;
unsigned long sleepmode_vibrate_counter = 0;
unsigned long previousMillis_sleep = 0;
unsigned long currentMillis = 0;
unsigned long previousMillis = 0; 
int set_temp_slide_counter = 32;
int set_temp_slide_counter_up = -32;

bool sleepmode = true;
bool temp_change = false;
bool sleepmode_vibrate = false;

double CurrentTemp;
#define ADC_MULTISAMPLING 5
#define ADC_MULTISAMPLING_SAMPLES (1 << ADC_MULTISAMPLING)

void setup() {
  pinMode(MOSFET_pin,OUTPUT);
  pinMode(increase_pin,INPUT);
  pinMode(decrease_pin,INPUT);
  pinMode(buzzer,OUTPUT);
  pinMode(vibrate,INPUT);
  pinMode(temp_sense,INPUT);

  PCICR |= B00000010;
  PCMSK1 |= B00000010;

  digitalWrite(MOSFET_pin,LOW);  
  digitalWrite(buzzer,LOW);   
  
  display.begin(SSD1306_SWITCHCAPVCC, 0x3C);
  delay(200);
  
  analogWrite(buzzer,200);
  delay(100);
  analogWrite(buzzer,LOW);

  display.clearDisplay();
  display.drawBitmap(0, 0,  no_press_logo, 128, 32, 1);
  display.display();  

  sleepmode_vibrate_counter = millis();
  
}

int map_temp_to_print(int temp)
{
  while (i < 800)
  {
     if(i_prev < temp && temp < i)
     {
        return i;
        i=800;
     }
     i_prev=i;
     i=i+5 ;    
  }
  i = 0;
}


float read_temperature()
{
  int adc = 0;
  for (int i = 0; i < ADC_MULTISAMPLING_SAMPLES; ++i)
    adc += analogRead(temp_sense);
    adc = adc >> ADC_MULTISAMPLING; 

  double temp =  0.9241*adc - 51.146;

  CurrentTemp += (temp-CurrentTemp)*0.05;
  return(CurrentTemp);
}


ISR(PCINT1_vect)
{
  previousMillis_sleep = currentMillis;
  sleepmode_vibrate = false;  
  delay(500);
}


void loop() {  
  currentMillis = millis();
  if(  (currentMillis - previousMillis >= Delay) &&  (!sleepmode && !temp_change && !sleepmode_vibrate))
  { 
    previousMillis += Delay;  
    digitalWrite(MOSFET_pin, LOW);
    delayMicroseconds(300);  
    temperature_read = read_temperature();

    uint32_t before, after;
    before = micros();
    uint8_t output = myPID.step(setpoint, temperature_read);  
    after = micros();
    
    analogWrite(MOSFET_pin, output);
      
    temp_to_print = map_temp_to_print(temperature_read);
    
    display.clearDisplay();
    display.setTextSize(2);
    display.setTextColor(WHITE);
    display.setCursor(10,0);

    display.print("Set: ");             
    display.setCursor(70,0);
    display.print(setpoint,1);
    display.setCursor(10,18);
    display.print("Temp: ");
    display.setCursor(70,18);
    display.print(temp_to_print,1); 
    display.display();                
  }
  
  if((digitalRead(increase_pin) || digitalRead(decrease_pin)) &&  sleepmode)
  {
    previousMillis_sleep = currentMillis;
    
    if(sleep_out_count > 1300)
    {
      analogWrite(buzzer,200);
      delay(70);
      analogWrite(buzzer,LOW);
      sleepmode = false;
      sleepmode_vibrate = false;
      sleep_out_count = 0;
      delay(100);
    }
    sleep_out_count = sleep_out_count + 1;      
  }
  
  
  if(digitalRead(increase_pin)  &&  !digitalRead(decrease_pin))
  {
    previousMillis_sleep = currentMillis;
    
    if(sleep_out_count > 4000)
    {

      temp_change = true;
      digitalWrite(MOSFET_pin,LOW); 
      sleep_out_count = 0;
      setpoint = setpoint + 5;
      if (setpoint > max_temp)
      {
       setpoint = max_temp;  
      }      
      display.clearDisplay();
      display.setTextSize(3);
      display.setTextColor(WHITE);
      display.setCursor(35,4);
      display.print(setpoint); 
      display.display(); 
    }
    sleep_out_count = sleep_out_count + 1;
//    while(digitalRead(increase_pin)){}
  }
  if(!digitalRead(increase_pin)  && digitalRead(decrease_pin))
  {
    previousMillis_sleep = currentMillis; 
    
    if(sleep_out_count > 4000)
    {
      
      temp_change = true;
      digitalWrite(MOSFET_pin,LOW);  
      sleep_out_count = 0;
      setpoint = setpoint - 5;

      if (setpoint < min_temp)
      {
        setpoint = min_temp;  
      }
      display.clearDisplay();
      display.setTextSize(3);
      display.setTextColor(WHITE);
      display.setCursor(35,4);
      display.print(setpoint);   
      display.display();
    }
    sleep_out_count = sleep_out_count + 1;      
  }

  
  if(!digitalRead(increase_pin) && !digitalRead(decrease_pin) && temp_change)
  {
    if(temp_change_count > 28000)
    {
      temp_change = false;
      temp_change_count = 0;
      set_temp_made = false;
      previousMillis_sleep = currentMillis;
    }
    temp_change_count = temp_change_count + 1;
//    while(!digitalRead(increase_pin) || !digitalRead(decrease_pin)){}    
  }
  
  if(digitalRead(increase_pin) && digitalRead(decrease_pin) && !sleepmode)
  {
    if(both_pressed_count > 25000)
    {
      analogWrite(buzzer,200);
      delay(70);
      analogWrite(buzzer,LOW);
      sleepmode=true;
      digitalWrite(MOSFET_pin,LOW);
      display.clearDisplay();
      display.setTextSize(3);
      display.setTextColor(WHITE);
      display.setCursor(20,4);
      display.print("SLEEP");   
      display.display(); 
      delay(2000);
      both_pressed_count=0;
    }
    both_pressed_count = both_pressed_count +1;
//    while(digitalRead(increase_pin) || digitalRead(decrease_pin)){}
  }


  if(sleepmode || sleepmode_vibrate)
  { 
    previousMillis_sleep = currentMillis;
    if(sleeplogo_count > 3000 && sleeplogo_count < 3005)
    {
      display.clearDisplay();
      display.drawBitmap(0, 0,  press_logo, 128, 32, 1);
      display.display();        
    }
    if(sleeplogo_count > 6000 && sleeplogo_count < 6005)
    {
      display.clearDisplay();
      display.drawBitmap(0, 0,  no_press_logo, 128, 32, 1);
      display.display();
      sleeplogo_count = 0;       
    }
    sleeplogo_count = sleeplogo_count + 1;         
  }
  
  
  if( (currentMillis - previousMillis_sleep >= sleep_time_detect) && sleepmode_vibrate == false)
  {
    sleepmode_vibrate = true;
    previousMillis_sleep = currentMillis;
    digitalWrite(MOSFET_pin,LOW);
    display.clearDisplay();
    display.setTextSize(3);
    display.setTextColor(WHITE);
    display.setCursor(20,4);
    display.print("SLEEP");   
    display.display(); 
    analogWrite(buzzer,200);
    delay(70);
    analogWrite(buzzer,LOW);
    delay(1000);
   }

}
